/* SPDX-License-Identifier: GPL-3.0-or-later
 * Generated by tools/build_atlas.py; atlas is not linked into firmware. */
#include "garden_assets.h"

const char garden_atlas_sha256[65] = "9131cd7e9da3b15a8e33bfbe179688ba57d1d712ce503b91a0cb76513cd2d936";
static const garden_sprite_t sprites[GARDEN_ASSET_COUNT] = {
    {0u, 23u, 30u, 46u, 11, 8}, /* 0: PLAYER */
    {1380u, 49u, 51u, 98u, 24, 19}, /* 1: DARTER1 */
    {6380u, 65u, 102u, 130u, 32, 71}, /* 2: STOPPER1 */
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    {159892u, 8u, 8u, 16u, 0, 0}, /* 177: FONT_CYAN_25 */
};

const garden_sprite_t *garden_asset(unsigned id)
{ return id < GARDEN_ASSET_COUNT ? &sprites[id] : 0; }

unsigned garden_bullet_id(unsigned type, unsigned colour, unsigned angle)
{
    unsigned rotation = ((angle + 64u) & 1023u) >> 7;
    if (colour < 1u || colour > 5u) colour = 3u;
    return (type == 2u ? GARDEN_ASSET_DIAMOND_BASE : GARDEN_ASSET_DART_BASE)
           + (colour - 1u) * 8u + rotation;
}

const garden_sprite_t *garden_bullet_asset(unsigned type, unsigned colour, unsigned angle)
{ return garden_asset(garden_bullet_id(type, colour, angle)); }

int garden_glyph(char c)
{
    static const char chars[] = " ABCDEFGHIJKLMNOPQRSTUVWXYZ0123456789:/-._%";
    unsigned i;
    if (c >= 'a' && c <= 'z') c = (char)(c - 'a' + 'A');
    for (i = 0; i < GARDEN_FONT_GLYPHS; ++i)
        if (chars[i] == c) return (int)(GARDEN_ASSET_FONT_WHITE_BASE + i);
    return -1;
}

const garden_sprite_t *garden_glyph_asset(char c, unsigned cyan)
{
    int id = garden_glyph(c);
    if (id < 0) return 0;
    return garden_asset((unsigned)id + (cyan ? GARDEN_FONT_GLYPHS : 0u));
}
