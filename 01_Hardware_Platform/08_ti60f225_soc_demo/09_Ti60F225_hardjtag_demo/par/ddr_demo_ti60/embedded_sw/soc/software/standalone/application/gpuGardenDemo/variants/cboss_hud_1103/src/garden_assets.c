/* SPDX-License-Identifier: GPL-3.0-or-later
 * Generated by tools/build_boss_stress_atlas.py; atlas is not linked into firmware. */
#include "garden_assets.h"

const char garden_atlas_sha256[65] = "48e6a628e02d68f1bbd86be37c85dcccd3df800d6c79aa3e58ccd5571a56b867";
static const garden_sprite_t sprites[GARDEN_ASSET_COUNT] = {
    {0u, 40u, 36u, 20, 18}, /* 0: PLAYER */
    {2880u, 40u, 44u, 20, 22}, /* 1: DARTER1 */
    {6400u, 72u, 68u, 36, 34}, /* 2: STOPPER1 */
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    {743532u, 78u, 78u, 39, 39}, /* 871: LARGE_BLAST_7 */
};

const garden_sprite_t *garden_asset(unsigned id)
{ return id < GARDEN_ASSET_COUNT ? &sprites[id] : 0; }

unsigned garden_bullet_id(unsigned type, unsigned colour, unsigned angle)
{
    unsigned rotation = ((angle + 64u) & 1023u) >> 7;
    if (colour < 1u || colour > 5u) colour = 3u;
    return (type == 2u ? GARDEN_ASSET_DIAMOND_BASE : GARDEN_ASSET_DART_BASE)
           + (colour - 1u) * 8u + rotation;
}

const garden_sprite_t *garden_bullet_asset(unsigned type, unsigned colour, unsigned angle)
{ return garden_asset(garden_bullet_id(type, colour, angle)); }

int garden_glyph(char c)
{
    static const char chars[] = " ABCDEFGHIJKLMNOPQRSTUVWXYZ0123456789:/-._%";
    unsigned i;
    if (c >= 'a' && c <= 'z') c = (char)(c - 'a' + 'A');
    for (i = 0; i < GARDEN_FONT_GLYPHS; ++i)
        if (chars[i] == c) return (int)(GARDEN_ASSET_FONT_WHITE_BASE + i);
    return -1;
}

const garden_sprite_t *garden_glyph_asset(char c, unsigned cyan)
{
    int id = garden_glyph(c);
    if (id < 0) return 0;
    return garden_asset((unsigned)id + (cyan ? GARDEN_FONT_GLYPHS : 0u));
}

/*Precision descriptors append without changing the old8direction API. */
unsigned garden_bullet_precision_id(unsigned type,unsigned colour,unsigned angle)
{
    unsigned rotation=((angle+8u)&1023u)>>4;
    if(colour<1u || colour>5u) colour=3u;
    if(!(rotation&7u)) return garden_bullet_id(type,colour,rotation*16u);
    return GARDEN_ASSET_PRECISION_BASE+(type==2u ? 5u:0u)*56u
           +(colour-1u)*56u+rotation-(rotation>>3)-1u;
}
unsigned garden_asset_is_enemy_bullet(unsigned id)
{
    return (id>=GARDEN_ASSET_DART_BASE && id<GARDEN_ASSET_FONT_WHITE_BASE) ||
           (id>=GARDEN_ASSET_PRECISION_BASE && id<GARDEN_ASSET_ORDNANCE_HIT_BASE);
}
